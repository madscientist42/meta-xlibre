## conf/layer.conf
```bitbake
# We have a conf and classes directory, add to BBPATH
BBPATH .= ":${LAYERDIR}"

# We have recipes-* directories, add to BBFILES
BBFILES += " \
	${LAYERDIR}/recipes-*/*/*.bb \
	${LAYERDIR}/recipes-*/*/*.bbappend \
	${LAYERDIR}/*/recipes-*/*/*.bb \
	${LAYERDIR}/*/recipes-*/*/*.bbappend \
	"

BBFILE_COLLECTIONS += "xlibre"
BBFILE_PATTERN_xlibre = "^${LAYERDIR}/"
BBFILE_PRIORITY_xlibre = "11"
LAYERVERSION_xlibre = "7"

# This reflects which version series of Yocto/OE that this layer
# is supposed to be built with.  For any new-ish version of the same,
# you should add the codename for the version series (eg. "sumo", etc.)
# to this list, separated by spaces...  Normally, the range of version
# lines in the sand is 4 plus whatever is the latest LTS versions for myself.
#
# If you're needing an older version that's EOLed that we're not using
# we'll be more than happy to see what needs to be done to support that-
# but the aforementioned is all we're going to do unless you step up and
# help maintain that all the same. Right now, we don't support the
# wrecking ball that is master, though that will change eventually.
LAYERSERIES_COMPAT_xlibre = "scarthgap"

# Recipe modifications for other layers that may be included in the build as
# we supply mods for more than just the core here.
BBFILES += "${@' '.join('${LAYERDIR}/external/%s/recipes*/*/*.bb' % layer \
               for layer in BBFILE_COLLECTIONS.split() if os.path.exists(os.path.join('${LAYERDIR}','external',layer)))}"
BBFILES += "${@' '.join('${LAYERDIR}/external/%s/recipes*/*/*.bbappend' % layer \
               for layer in BBFILE_COLLECTIONS.split() if os.path.exists(os.path.join('${LAYERDIR}','external',layer)))}"
```
